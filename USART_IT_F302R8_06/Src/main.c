
/* USER CODE BEGIN 0 */
/*
*    Generated by Code_Generation toolbox of Xcos with scilab-5.5.2
*    Date : 09-Oct-2020
*/
/* ---- Headers ---- */
#include <stdio.h>
#include <string.h> // memcpy
#include "STM32_Config.h"

#include "scicos_block4.h"
#include "USART_IT_F302R8_06.h"
/* ---- Variables declaration ---- */
/* Number of auto reload timer rotation computed */
static uint32_t autoReloadTimerLoopVal_S = 1;
/* Remaining number of auto reload timer rotation to do */
static uint32_t remainAutoReloadTimerLoopVal_S = 1;
#define NB_SOLVER_LOOP_FOR_STEP1 1 //Nb of solver loop to do before trigging Step function
static uint32_t autoReloadTimerLoopStep1_S = NB_SOLVER_LOOP_FOR_STEP1; //Step function called from main

/* USER CODE END 0 */

/****************************************************
            main function
Example of main : 
  - Clock configuration
  - call Initialize
  - Wait for systick (infinite loop)
*****************************************************/
int main (void)
{
/* USER CODE BEGIN 1 */
/* Data initialization */
//int_T i;
/* USER CODE END 1 */

/* USER CODE BEGIN 2 */
/* Systick configuration and enable SysTickHandler interrupt */
if (SysTick_Config((uint32_t)(SystemCoreClock * 0.5)))
{
   autoReloadTimerLoopVal_S = 1;
   do {
      autoReloadTimerLoopVal_S++;
   } while((uint32_t)(SystemCoreClock * 0.5)/autoReloadTimerLoopVal_S > SysTick_LOAD_RELOAD_Msk);
   SysTick_Config((uint32_t)(SystemCoreClock * 0.5)/autoReloadTimerLoopVal_S);
} //End if
remainAutoReloadTimerLoopVal_S = autoReloadTimerLoopVal_S; //Set nb of loop to do 
/* USER CODE END 2 */

/* USER CODE BEGIN WHILE */

/* Model initialization call */
USART_IT_F302R8_06_Initialize();

/* Infinite loop */
/* Real time from systickHandler */
while(1) {
   /*Process tasks every solver time*/
   if(remainAutoReloadTimerLoopVal_S == 0) {
      remainAutoReloadTimerLoopVal_S = autoReloadTimerLoopVal_S;
      autoReloadTimerLoopStep1_S--;
      if (autoReloadTimerLoopStep1_S == 0) {
         autoReloadTimerLoopStep1_S = NB_SOLVER_LOOP_FOR_STEP1;
         USART_IT_F302R8_06_Step1();
      }//End if
   } //End if
} //End while
/* USER CODE END WHILE */

/* USER CODE BEGIN 3 */
/* USER CODE END 3 */
} //End main

/* USER CODE BEGIN 4 */
/****************************************************
SysTick_Handler callback function
This handler is called every tick and schedules tasks
*****************************************************/
void HAL_SYSTICK_Callback(void)
{
   /* For TIME OUT processing */
   HAL_IncTick();
   /* inc time ref */
   sci_time++;
   /* Manage nb of loop before interrupt has to be processed */
   if( remainAutoReloadTimerLoopVal_S) {
      remainAutoReloadTimerLoopVal_S--;
   } //End if
} //End HAL_SYSTICK_Callback
/* USER CODE END 4 */

